## esp32/sdkconfig.defaults
```kconfig
#
# ESP-IDF Configuration for TETRA-ESP32
#

CONFIG_ESPTOOLPY_FLASHSIZE_4MB=y
CONFIG_ESPTOOLPY_FLASHFREQ_80M=y
CONFIG_PARTITION_TABLE_SINGLE_APP=y

CONFIG_FREERTOS_HZ=1000
CONFIG_LWIP_MAX_SOCKETS=16

CONFIG_ESP_WIFI_STATIC_RX_BUFFER_NUM=10
CONFIG_ESP_WIFI_DYNAMIC_RX_BUFFER_NUM=32
CONFIG_ESP_WIFI_DYNAMIC_TX_BUFFER_NUM=32

CONFIG_LOG_DEFAULT_LEVEL_INFO=y
CONFIG_ESP_LOG_MAXIMUM_LEVEL_VERBOSE=y
```
